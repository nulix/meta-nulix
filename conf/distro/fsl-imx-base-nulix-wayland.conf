## conf/distro/fsl-imx-base-nulix-wayland.conf
```bitbake
require conf/distro/fsl-imx-base-ezurio.conf

DISTRO = "fsl-imx-base-nulix-wayland"
DISTRO_NAME = "NULIX Wayland"

DISTRO_FEATURES:remove = "directfb x11 "
DISTRO_FEATURES:append = " wayland pam"
```
