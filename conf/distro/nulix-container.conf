## conf/distro/nulix-container.conf
```bitbake
require conf/distro/poky.conf

DISTRO = "nulix-container"
DISTRO_NAME = "Nulix Container"
DISTRO_CODENAME = "nulix-container"

SDK_VENDOR = "-nulixcontainersdk"

MAINTAINER = "Matija Tudan <matija.tudan@nulix.hr>"
TARGET_VENDOR = "-nulixcontainer"

TCLIBC = "musl"

DISTRO_FEATURES = "acl ipv4 ipv6 largefile xattr ${DISTRO_FEATURES_LIBC}"

VIRTUAL-RUNTIME_dev_manager ?= ""
VIRTUAL-RUNTIME_login_manager ?= ""
VIRTUAL-RUNTIME_init_manager ?= ""
VIRTUAL-RUNTIME_initscripts ?= ""
VIRTUAL-RUNTIME_keymaps ?= ""
```

## conf/distro/nulix-target.conf
```bitbake
require conf/distro/poky.conf

DISTRO = "nulix-target"
DISTRO_NAME = "Nulix Target"
DISTRO_CODENAME = "nulix-target"

SDK_VENDOR = "-nulixtargetsdk"

MAINTAINER = "Matija Tudan <matija.tudan@nulix.hr>"
TARGET_VENDOR = "-nulixtarget"

TCLIBC = "musl"

DISTRO_FEATURES:append = " virtualization"

INIT_MANAGER = "openrc"
```

## conf/layer.conf
```bitbake
# We have a conf and classes directory, add to BBPATH
BBPATH .= ":${LAYERDIR}"

# We have recipes-* directories, add to BBFILES
BBFILES += "${LAYERDIR}/recipes-*/*/*.bb \
            ${LAYERDIR}/recipes-*/*/*.bbappend"

BBFILE_COLLECTIONS += "meta-nulix"
BBFILE_PATTERN_meta-nulix = "^${LAYERDIR}/"
BBFILE_PRIORITY_meta-nulix = "6"

LAYERDEPENDS_meta-nulix = "core"
LAYERSERIES_COMPAT_meta-nulix = "kirkstone nanbield scarthgap"
```
